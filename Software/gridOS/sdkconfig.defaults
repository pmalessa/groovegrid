## Software/gridOS/sdkconfig.defaults
```kconfig
#Those settings are used to generate sdkconfig together with default values

CONFIG_ESPTOOLPY_FLASHSIZE_4MB=y

CONFIG_PARTITION_TABLE_CUSTOM=y
CONFIG_PARTITION_TABLE_CUSTOM_FILENAME="partition_gridOS.csv"
CONFIG_PARTITION_TABLE_FILENAME="partition_gridOS.csv"
CONFIG_PARTITION_TABLE_OFFSET=0x8000
CONFIG_PARTITION_TABLE_MD5=y

CONFIG_BT_ENABLED=y
CONFIG_BTDM_CTRL_MODE_BLE_ONLY=y

CONFIG_ESP32_DEFAULT_CPU_FREQ_240=y
CONFIG_ESP32_DEFAULT_CPU_FREQ_MHZ=240

# CONFIG_OTA_ALLOW_HTTP is not set

CONFIG_FREERTOS_HZ=1000

CONFIG_LWIP_TCPIP_TASK_STACK_SIZE=3072
CONFIG_TCPIP_TASK_STACK_SIZE=3072

CONFIG_LOG_DEFAULT_LEVEL_INFO=y
CONFIG_LOG_DEFAULT_LEVEL=3

CONFIG_ESP_TLS_SERVER=y
CONFIG_MBEDTLS_DEBUG=n
```
